## CMakeLists.txt
```
cmake_minimum_required(VERSION 3.13.1)

#include(../../../awareable.cmake)
find_package(Zephyr REQUIRED HINTS $ENV{ZEPHYR_BASE})

project(pm)

target_sources(app PRIVATE src/main.c)
```

## prj.conf
```kconfig
CONFIG_GPIO=y

#meer configs
#4096 is too high
#CONFIG_SHELL=y
#CONFIG_LOG_MODE_IMMEDIATE=y
#CONFIG_STDOUT_CONSOLE=y

#CONFIG_LOG_PROCESS_THREAD_SLEEP_MS=2100
CONFIG_LOG=y
CONFIG_MAIN_STACK_SIZE=8192
CONFIG_IDLE_STACK_SIZE=8192

CONFIG_PM=y
```

## src/main.c
```c
#include <zephyr/kernel.h>
#include <zephyr/device.h>
#include <zephyr/devicetree.h>
#include <zephyr/drivers/gpio.h>

#include <zephyr/pm/pm.h>
#include <zephyr/pm/device_runtime.h>

#include <zephyr/sys/printk.h>
#include <fsl_gpio.h>



static struct pm_state_info pm_info_standby = {PM_STATE_STANDBY, 0, 0, 0};

int main(void)
{

    LED_0_ON();
    printk("2 second cooldown\n");
    k_sleep(K_MSEC(2000));
    LED_0_OFF();
    printk("Entering sleep in 4 seconds\n"); //printen vlak voor slaapstand gaat niet, heeft delay nodig
    k_sleep(K_MSEC(2000));
    LED_0_ON();
    k_sleep(K_MSEC(2000));
    pm_state_force(0u, &pm_info_standby); //put delay before forcing state, otherwise tasks arent finished.
    LED_0_ON();

    while(1){
        k_sleep(K_MSEC(2000));
        printk("AWAKE");
    }
}

void WarmMain(void)
{
    main();
}
```
