## soc/arm/nxp_k32/k32/Kconfig.series
```kconfig
# NXP K32 series
#
# Copyright (c) 2021, Vincent van der Locht
# Copyright (c) 2022, Hessel van der Molen, sendrato.com
#
# SPDX-License-Identifier: Apache-2.0
#

config SOC_SERIES_K32
	bool "NXP K32 Series MCU"
	select ARM
	select HAS_MCUX
	select HAS_MCUX_RNG
	select HAS_MCUX_FLEXCOMM
	select HAS_MCUX_SYSCON
	select SOC_FAMILY_K32
	select CPU_CORTEX_M_HAS_SYSTICK
	help
	  Enable support for NXP K32 MCU series
```

## soc/arm/nxp_k32/k32/Kconfig.soc
```kconfig
# NXP K32 series
#
# Copyright (c) 2021, Vincent van der Locht
# Copyright (c) 2022, Hessel van der Molen, sendrato.com
#
# SPDX-License-Identifier: Apache-2.0
#

choice
	prompt "NXP K32xxx MCU Selection"
	depends on SOC_SERIES_K32

config SOC_QN9090
	bool "SOC_QN9090"
	select CPU_CORTEX_M4
	select CPU_CORTEX_M_HAS_DWT
	select CPU_HAS_ARM_MPU
	select CLOCK_CONTROL
    select HAS_PM
	select HAS_MCUX_IAP_K32
    select CONFIG_BUILD_OUTPUT_HEX

endchoice

if SOC_SERIES_K32

config SOC_PART_NUMBER_K32_QN9090THN
	bool

config SOC_PART_NUMBER
	string
    default "QN9090THN" if SOC_PART_NUMBER_K32_QN9090THN
	help
	  This string holds the full part number of the SoC. It is a hidden
	  option that you should not set directly. The part number selection
	  choice defines the default value for this string.

endif # SOC_SERIES_K32
```

## subsys/nfc/Kconfig
```kconfig
#
# Copyright (c) 2018 Nordic Semiconductor
# Copyright (c) 2021 Sendrato BV
#
# SPDX-License-Identifier: LicenseRef-Nordic-5-Clause
#

menu "NFC"

config NFC
  bool "NFC subsystem"
  default n
  help
    This option enables the NFC subsystem.

if NFC

rsource "ndef/Kconfig"
rsource "t2t/Kconfig"
rsource "t4t/Kconfig"
rsource "tnep/Kconfig"

endif # NFC

endmenu
```
