## boards/arm/dk6_qn9090/Kconfig.board
```kconfig
#
# Copyright (c) 2021, Vincent van der Locht
# Copyright (c) 2022, Hessel van der Molen, sendrato.com
#
# SPDX-License-Identifier: Apache-2.0
#

config BOARD_DK6_QN9090
	bool "NXP QN9090DK6"
    depends on SOC_SERIES_K32
    select SOC_PART_NUMBER_K32_QN9090THN
```

## boards/arm/dk6_qn9090/Kconfig.defconfig
```kconfig
#
# Copyright (c) 2021, Vincent van der Locht
# Copyright (c) 2022, Hessel van der Molen, sendrato.com
#
# SPDX-License-Identifier: Apache-2.0
#

config BOARD
	default "dk6_qn9090" if BOARD_DK6_QN9090
```

## boards/arm/dk6_qn9090/dk6_qn9090_defconfig
```kconfig
#
# Copyright (c) 2021, Vincent van der Locht
# Copyright (c) 2022, Hessel van der Molen, sendrato.com
#
# SPDX-License-Identifier: Apache-2.0
#

CONFIG_SOC_SERIES_K32=y
CONFIG_SOC_QN9090=y
CONFIG_BOARD_DK6_QN9090=y
CONFIG_CONSOLE=y
CONFIG_UART_CONSOLE=y
CONFIG_SERIAL=y
CONFIG_UART_INTERRUPT_DRIVEN=y
CONFIG_CORTEX_M_SYSTICK=y
CONFIG_GPIO=y
CONFIG_PINMUX=y
CONFIG_SYS_CLOCK_HW_CYCLES_PER_SEC=48000000
CONFIG_ARM_MPU=y

CONFIG_HW_STACK_PROTECTION=y
```

## boards/arm/lpcxpressok32w061/Kconfig.board
```kconfig
# LPCXpresso54114 board

# Copyright (c) 2021, Vincent van der Locht
# SPDX-License-Identifier: Apache-2.0

config BOARD_LPCXPRESSOK32W061
	bool "NXP LPCXPRESSO-K32W061"
    depends on SOC_SERIES_K32
	select SOC_PART_NUMBER_K32W061HN
```

## boards/arm/lpcxpressok32w061/Kconfig.defconfig
```kconfig
# LPCXpresso54114 board

# Copyright (c) 2021, Vincent van der Locht
# SPDX-License-Identifier: Apache-2.0

if BOARD_LPCXPRESSOK32W061

config BOARD
	default "lpcxpressok32w061" if BOARD_LPCXPRESSOK32W061

if PINMUX_MCUX_LPC

config PINMUX_MCUX_LPC_PORT0
	default y

endif # PINMUX_MCUX_LPC

if GPIO_MCUX_LPC

config GPIO_MCUX_LPC_PORT0
	default y

endif # GPIO_MCUX_LPC

#config SPI_5
#	default y
#	depends on SPI

endif # BOARD_LPCXPRESSOK32W061
```

## boards/arm/lpcxpressok32w061/lpcxpressok32w061_defconfig
```kconfig
#
# Copyright (c) 2021, Vincent van der Locht
#
# SPDX-License-Identifier: Apache-2.0
#

CONFIG_SOC_SERIES_K32=y
CONFIG_SOC_K32W061=y
CONFIG_BOARD_LPCXPRESSOK32W061=y
CONFIG_CONSOLE=y
CONFIG_UART_CONSOLE=y
CONFIG_SERIAL=y
CONFIG_UART_INTERRUPT_DRIVEN=y
CONFIG_CORTEX_M_SYSTICK=y
CONFIG_GPIO=y
CONFIG_PINMUX=y
CONFIG_SYS_CLOCK_HW_CYCLES_PER_SEC=48000000
CONFIG_ARM_MPU=y
CONFIG_HW_STACK_PROTECTION=y
```

## drivers/modem/Kconfig.nordic-nrf9160
```kconfig
#
# Copyright (c) 2023 Sendrato
#
# SPDX-License-Identifier: Apache-2.0
#

config MODEM_NORDIC_NRF9160
	bool "Nordic nRF9160 modem driver"
	select MODEM_MODULES
	select MODEM_CHAT
	select MODEM_PIPE
	select MODEM_BACKEND_UART
	select MODEM_SOCKET
	select RING_BUFFER
	select NET_SOCKETS_OFFLOAD
	help
		Choose this setting to enable Nordic nRF9160 modem driver.
		The driver is implemented assuming the nRf9160 is running
		the Nordic's Serial LTE Monitor application available in
		nRF SDK.

if MODEM_NORDIC_NRF9160

config MODEM_NORDIC_NRF9160_AUTOINIT
	bool "Config to disable driver autoinit, will be necessary to call pm_device_action_run(RESUME) and net_if_up()"
	default y

config MODEM_NORDIC_NRF9160_RX_RINGBUF_SIZE
	int "RX ringbuffer size, used to received data from sockets"
	default 512
	help
		This ring buffer is used when receiving data from a socket.
		From the modem we can only get all the data at once, this way
		it's possible to return only the amount of data that has been
		requested by the application.

config MODEM_NORDIC_NRF9160_UART_RX_BUF_SIZE
	int "RX buffer used by uart backend to receive data from the modem"
	default 512
	help
		If using interrupt based UART the buffer will be split in:
		 - 1/2 Receive (ring)buffer 0
		 - 1/2 Receive (ring)buffer 1
		If using async UART the buffer will be split in:
		 - 1/4 UART receive buffer 0
		 - 1/4 UART receive buffer 1
		 - 2/4 Received data (ring)buffer

config MODEM_NORDIC_NRF9160_UART_TX_BUF_SIZE
	int "TX buffer used by uart backend to transmit data to the modem"
	default 1024
	help
		The buffer will be entirely used as UART transmit buffer

config MODEM_NRF9160_APN
	string "APN"
	default ""

config MODEM_NORDIC_NRF9160_INIT_PRIORITY
	int "Nordic nRF9160 driver init priority"
	default 80
	help
		Nordic nRF9160 device driver initialization priority.
		Do not mess with it unless you know what you are doing.
		Note that the priority needs to be lower than the net stack
		so that it can start before the networking sub-system.

config MODEM_NORDIC_NRF9160_NET_IF_INIT_PRIORITY
	int "Nordic nRF9160 network interface init priority"
	default 79
	help
		Nordic nRF9160 network interface initialization priority.
		This priority value must be lower than
		MODEM_NORDIC_NRF9160_INIT_PRIORITY to be able to have the
		network interface automatically enabled at boot. The device
		associated to the network interface must be initialized
		for the net_if_up() API to succeed, this config controls
		the init priority of such device.

config MODEM_NORDIC_NRF9160_WORKQ_STACK_SIZE
	int "Modem work queue stack size"
	default 768

config MODEM_NORDIC_NRF9160_WORKQ_PRV_INIT_PRIORITY
	int "Modem Nordic nRF9160 driver thread priority (0 - CONFIG_NUM_PREEMPT_PRIORITIES)"
	default 7
	help
		Priority of the Nordic nRf9160 driver workq in the Zephyr stack upon initialisation.

choice MODEM_NRF9160_NETWORK_MODE
	prompt "Network mode used during modem initialization"
	default MODEM_NRF9160_MODE_LTE_ONLY
	help
		nRF9160 modem can be configured to enable different
		network modes. A combination of LTE, NB-IoT and GNSS
		can be selected, with the possibility to specify
		a preference. In this implementation GNSS is always
		enabled.

config MODEM_NRF9160_MODE_LTE_ONLY
	bool "Network mode LTE-M only"
	help
		Enabling this mode the
		modem will use only LTE-M to
		connect to the network.
		GNSS will still be enabled.

config MODEM_NRF9160_MODE_DUAL
	bool "Network mode dual LTE-M and NB-IOT"
	help
		Enabling this mode the modem
		will be able to use both LTE-M
		and NB-IOT to connect to the network.
		GNSS will still be enabled.

config MODEM_NRF9160_MODE_DUAL_LTE_PREF
	bool "Network mode dual LTE-M and NB-IOT, with preference for LTE-M"
	help
		Using this mode the modem
		will be able to use both
		LTE-M and NB-IOT to connect
		to the network, with a preference
		for LTE-M.
		GNSS will still be enabled.

endchoice

config MODEM_NRF9160_COEX0_CMD
	string "Command used to configure COEX0 pin"
	default "AT%XCOEX0"
	help
		Command used to configure COEX0 pin controlled by modem.
		If COEX0 pin needs to be enabled, the config should
		contain the whole command to be sent e.g.
		"AT%XCOEX0=1,1,1570,1580"

config MODEM_NRF9160_MAGPIO_CMD
	string "Command used to configure MAGPIO pins"
	default "AT%XMAGPIO"
	help
		Command used to configure MAGPIO pins controlled by modem.
		If MAGPIO pins need to be enabled, the config should
		contain the whole command to be sent e.g.
		"AT%XMAGPIO=1,1,1,1,0,1574,1577"

config MODEM_NRF9160_EXTERNAL_ALMANAC
	bool "External almanac data and data-checksum to be set to the modem"
	help
		External almanac data and data-checksum to be set to the modem.
		If this config is enabled the driver expects to find two defines
		FACTORY_ALMANAC_DATA_V2 and FACTORY_ALMANAC_DATA_CHECKSUM_V2 to
		be sent to the modem to improve GNSS time to fix.

endif
```

## drivers/nfc/Kconfig
```kconfig
# Copyright (c) 2021, Sendrato.com, All rights reserved.
#
# This software is the confidential and proprietary information of Sendrato
# and is subject to the terms and conditions defined in file 'LICENSE.txt',
# which is part of this source code package. You shall not disclose such
# Confidential Information and shall use it only in accordance with the terms
# of the license agreement you entered into with Sendrato.
#
# 2021, Sendrato, Hessel van der Molen
#
# NFC drivers

rsource "Kconfig.nt3h2x11"
rsource "Kconfig.nrfxnfc"
```

## drivers/nfc/Kconfig.nrfxnfc
```kconfig
# Copyright (c) 2021, Sendrato.com, All rights reserved.
#
# This software is the confidential and proprietary information of Sendrato
# and is subject to the terms and conditions defined in file 'LICENSE.txt',
# which is part of this source code package. You shall not disclose such
# Confidential Information and shall use it only in accordance with the terms
# of the license agreement you entered into with Sendrato.
#
# 2021, Sendrato, Hessel van der Molen
#
# NRFXNFC: nRFx-NFC driver
#

config NRFXNFC
    bool "nRFx-NFC driver"
    default n
    help
        Enable nRFx NFC driver.

if NRFXNFC

config NRFXNFC_DRV_NAME
    string "Device Tree name of nRFx-NFC driver"
    default "nRFxNFC"
    help
        Device Tree name of nRFx-NFC driver.

config NRFXNFC_T2T
    bool "Enable NFC Type 2 Tag library"
    default n
    select NFC_T2T_NRFXLIB

config NRFXNFC_T4T
    bool "Enable NFC Type 4 Tag library"
    default n
    select NFC_T4T_NRFXLIB

config NRFXNFC_INIT_PRIORITY
    int "NRFXNFC NFC driver init priority"
    default 75

config NRFXNFC_MAX_PAYLOAD_SIZE
    int "Max payload in bytes"
    default 988

rsource "nrfxnfc/Kconfig"

endif # NRFXNFC
```

## drivers/nfc/Kconfig.nt3h2x11
```kconfig
# Copyright (c) 2021, Sendrato.com, All rights reserved.
#
# This software is the confidential and proprietary information of Sendrato
# and is subject to the terms and conditions defined in file 'LICENSE.txt',
# which is part of this source code package. You shall not disclose such
# Confidential Information and shall use it only in accordance with the terms
# of the license agreement you entered into with Sendrato.
#
# 2021, Sendrato, Hessel van der Molen
#
# NT3H2X11: NFC driver
#

config NT3H2X11
    bool "NT3H2X11 NFC driver"
    default n
    depends on I2C
    help
      Enable I2C-based driver for NT3H2X11 led driver.

if NT3H2X11

config NT3H2X11_2K
    bool "Use 2k memory map instead of 1k"
    default n
    help
      Use 2k memory map instead of 1k

config NT3H2X11_MAX_WRITE_DELAY
    int "delay in ms"
    default 10
    help
      Max I2C write delay in ms for when writing EEPROM

config NT3H2X11_INIT_PRIORITY
    int "NT3H2X11 NFC driver init priority"
    default 75

module = NT3H2X11
module-str = nt3h2x11
source "${ZEPHYR_BASE}/subsys/logging/Kconfig.template.log_config"

endif # NT3H2X11
```

## dts/bindings/gnss/nordic,nrf9160-gnss.yaml
```yaml
# SPDX-License-Identifier: Apache-2.0
# Copyright (c) 2023, Sendrato.com, All rights reserved.

description: Nordic nRF9160 GNSS modem

compatible: "nordic,nrf9160-gnss"

include:
  - uart-device.yaml
  - gnss-pps.yaml
```

## dts/bindings/modem/nordic,nrf9160.yaml
```yaml
# SPDX-License-Identifier: Apache-2.0
# Copyright (c) 2023, Sendrato.com, All rights reserved.

description: Nordic nRF9160 modem

compatible: "nordic,nrf9160"

include: uart-device.yaml

properties:
  mdm-power-gpios:
    type: phandle-array

  mdm-reset-gpios:
    type: phandle-array
```

## dts/bindings/nfc/nfc,nt3h2x11.yaml
```yaml
# Copyright (c) 2021, Sendrato.com, All rights reserved.
#
# This software is the confidential and proprietary information of Sendrato
# and is subject to the terms and conditions defined in file 'LICENSE.txt',
# which is part of this source code package. You shall not disclose such
# Confidential Information and shall use it only in accordance with the terms
# of the license agreement you entered into with Sendrato.
#
# 2021, Sendrato, Hessel van der Molen
#
# DTS for NT3H2X11: NXP NTAG driver
#

description: NXP NT3H2X11 IC

compatible: "nxp,nt3h2X11"

include: i2c-device.yaml

properties:
  irq-gpios:
    type: phandle-array
    required: false
    description: |
      The INT signal configuration is active-low.
```

## dts/bindings/power/sendrato,expanded-power-configs-base-array-test.yaml
```yaml
description: qn9090 power management configuration for domains

compatible: "sendrato,expanded-power-configs-base-array-test"

properties:

  suspend-to-ram-configs:
    type: string-array
    required: false
    description: Array containing all changeable configurations for the suspend-to-ram state

  gpio-wakeup:
    type: array
    required: false
    description: bool to decide if wakeup source is GPIO

  timer-wakeup:
    type: array
    required: false
    description: bool to decide if wakeup source is timer

  retain-ram-domain: #retain sram
    type: array
    required: false
    description: bool to decide if RAM should be retained between boots

  retain-radio-device: #retain radio
    type: array
    required: false
    description: bool to decide if radio config should be retained between boots
```

## dts/bindings/power/sendrato,expanded-power-configs-base-substate.yaml
```yaml
description: qn9090 power management configuration for domains

compatible: "sendrato,expanded-power-configs-base-substate"

properties:

  gpio-wakeup:
    type: array
    required: false
    description: bool to decide if wakeup source is GPIO

  timer-wakeup:
    type: array
    required: false
    description: bool to decide if wakeup source is timer

  retain-ram-domain:
    type: array
    required: false
    description: bool to decide if RAM should be retained between boots

  retain-radio-device:
    type: array
    required: false
    description: bool to decide if radio config should be retained between boots
```

## dts/bindings/power/sendrato,expanded-power-configs-sustoram-substate.yaml
```yaml
description: qn9090 power management configuration for domains

compatible: "sendrato,expanded-power-configs-sustoram-substate"

include:
  - name: sendrato,expanded-power-configs-base-substate.yaml
    property-allowlist:
      - gpio-wakeup
      - timer-wakeup
      - retain-ram-domain
      - retain-radio-device
```

## dts/bindings/power/sendrato,expanded-power-configs-sustoram.yaml
```yaml
description: qn9090 power management configuration for domains

compatible: "sendrato,expanded-power-configs-sustoram"

include:
  - name: sendrato,expanded-power-configs-base.yaml
    property-allowlist:
      - gpio-wakeup
      - timer-wakeup
      - retain-ram-domain
      - retain-radio-device
```

## dts/bindings/power/sendrato,expanded-power-configs.yaml
```yaml
description: qn9090 power management configuration for sleep modes

#TODO: Could be changed to have a different yaml file for each power state so that available configs are shown per state.

compatible: "sendrato,expanded-power-configs"

include: zephyr,power-state.yaml

properties:

  gpio-wakeup:
    type: boolean
    required: false
    description: bool to decide if wakeup source is GPIO

  timer-wakeup:
    type: boolean
    required: false
    description: bool to decide if wakeup source is timer

  retain-ram-domain:
    type: boolean
    required: false
    description: bool to decide if RAM should be retained between boots

  retain-radio-device:
    type: boolean
    required: false
    description: bool to decide if radio config should be retained between boots

  autostart-32mhz-xtal:
    type: boolean
    required: false
    description: bool to decide if 32mhz crystla should autostart on reboot. Might be required if this is system clock before sleep.
```

## samples/drivers/nfc/boards/mg100.conf
```kconfig
#
# Copyright (c) 2023 Sendrato
#
# SPDX-License-Identifier: Apache-2.0
#

CONFIG_NRFXNFC=y
CONFIG_NRFXNFC_T2T=y
```

## soc/arm/nxp_k32/Kconfig
```kconfig
# NXP K32 family
#
# Copyright (c) 2021, Vincent van der Locht
# Copyright (c) 2022, Hessel van der Molen, sendrato.com
#
# SPDX-License-Identifier: Apache-2.0
#

config SOC_FAMILY_K32
	bool
	select HAS_SEGGER_RTT

if SOC_FAMILY_K32

config SOC_FAMILY
	string
	default "nxp_k32"

source "soc/arm/nxp_k32/*/Kconfig.soc"

endif # SOC_FAMILY_K32
```
