## soc/arm/nxp_k32/Kconfig.defconfig
```kconfig
# NXP K32 family
#
# Copyright (c) 2021, Vincent van der Locht
# Copyright (c) 2022, Hessel van der Molen, sendrato.com
#
# SPDX-License-Identifier: Apache-2.0
#

source "soc/arm/nxp_k32/*/Kconfig.defconfig.series"

config I2C_MCUX_FLEXCOMM
	default y if HAS_MCUX_FLEXCOMM
	depends on I2C

config SPI_MCUX_FLEXCOMM
	default y if HAS_MCUX_FLEXCOMM
	depends on SPI

config CLOCK_CONTROL_MCUX_SYSCON
	default y if HAS_MCUX_SYSCON
	depends on CLOCK_CONTROL

config MCUX_MIDDLEWARE_MEMMANAGER_HEAP_SIZE
    int "MemManager Heap-size"
    default 1024
    help
        Maximum number of bytes available for MemManager in the mcux middleware.

config HAS_PM
    bool "Supports Power-Management"
    default y
    help
        Has working PM support.
```

## soc/arm/nxp_k32/Kconfig.soc
```kconfig
# NXP K32 family
#
# Copyright (c) 2021, Vincent van der Locht
# Copyright (c) 2022, Hessel van der Molen, sendrato.com
#
# SPDX-License-Identifier: Apache-2.0
#

source "soc/arm/nxp_k32/*/Kconfig.series"
```

## soc/arm/nxp_k32/k32/Kconfig.defconfig.k32w061
```kconfig
# NXP K32W061 platform configuration options

# Copyright (c) 2021, Vincent van der Locht
# SPDX-License-Identifier: Apache-2.0

if SOC_K32W061

config SOC
	default "k32w061"

config PINMUX_MCUX_LPC
	default y
	depends on PINMUX

config GPIO_MCUX_LPC
	default y
	depends on GPIO

config UART_MCUX_FLEXCOMM
	default y
	depends on SERIAL

config SOC_FLASH_MCUX
	default y
	depends on FLASH

endif # SOC_K32W061
```

## soc/arm/nxp_k32/k32/Kconfig.defconfig.qn9090
```kconfig
# NXP QN9090T platform configuration options

# Copyright (c) 2021, Vincent van der Locht
# SPDX-License-Identifier: Apache-2.0

if SOC_QN9090

config SOC
	default "qn9090"

config PINMUX_MCUX_LPC
	default y
	depends on PINMUX

config GPIO_MCUX_LPC
	default y
	depends on GPIO

config UART_MCUX_FLEXCOMM
	default y
	depends on SERIAL

config SOC_FLASH_MCUX
	default y
	depends on FLASH


endif # SOC_QN9090
```

## soc/arm/nxp_k32/k32/Kconfig.defconfig.series
```kconfig
# NXP K32 series
#
# Copyright (c) 2021, Vincent van der Locht
# Copyright (c) 2022, Hessel van der Molen, sendrato.com
#
# SPDX-License-Identifier: Apache-2.0
#

if SOC_SERIES_K32

config SOC_SERIES
	default "k32"

config NUM_IRQS
	# must be >= the highest interrupt number used
	default 56

source "soc/arm/nxp_k32/k32/Kconfig.defconfig.qn*"

endif # SOC_SERIES_K32
```
